## arch/gpt/Kconfig
```kconfig
menu "GPT architecture"
	depends on GPT

config SYS_ARCH
	default "gpt"

config 64BIT
	bool

config GPT_CHIP1
	bool
	select 64BIT
config GPT_CHIP2
	bool
	select 64BIT

config SYS_CPU
	default "chip1" if GPT_CHIP1
	default "chip2" if GPT_CHIP2

menu "GPT clock settings"

source "arch/gpt/mach-chip2/Kconfig"

endmenu

config SYS_OUT_OF_ORDER_OFF
        bool "Do not enable CPU out of order"
        default n

config SYS_ICACHE_OFF
        bool "Do not use Instruction Cache"
        default n

config SYS_DCACHE_OFF
        bool "Do not use Data Cache"
        default y

config SYS_L2CACHE_OFF
        bool "Do not use L2 Cache"
        default y

config GPT_CACHE_LINE_SHIFT
        int
        range 5 7
        default "5" if GPT_CHIP1 || GPT_CHIP2
        help
          This option specifies "N", with Line-len = 2 power N
          So line lengths of 32, 64, 128 are specified by 5,6,7, respectively
          Linux only supports same line lengths for I and D caches.

config GPT_SMP_SUPPORT
	bool "GPT SMP boot up support"
	default n

choice
	prompt "Target select"
	optional

config TARGET_CHIP1_FPGA
	bool "Support chip1 fpga board"
	select GPT_CHIP1
config TARGET_CHIP1_EVK
	bool "Support gpt chip1 board"
	select GPT_CHIP1
config TARGET_CHIP2_FPGA
	bool "Support chip2 fpga board"
	select GPT_CHIP2
	select SUPPORT_SPL
config TARGET_CHIP2_EVK
	bool "Support chip2 evk board"
	select GPT_CHIP2
config TARGET_CHIP2_SIM
	bool "Support chip2 simulation"
	select GPT_CHIP2
config TARGET_CHASE_XILINX
	bool "Support chase xilinx board"
	select GPT_CHIP2
config TARGET_GP8300_FPGA
	bool "Support gp8300 fpga board"
	select GPT_CHIP2
	select SUPPORT_SPL
config TARGET_GP8300_EVK
	bool "Support gp8300 evk board"
	select GPT_CHIP2
	select SUPPORT_SPL
config TARGET_GP8300_DVB
	bool "Support gp8300 dvb board"
	select GPT_CHIP2
	select SUPPORT_SPL
config TARGET_GP8300_CHAOKONG
	bool "Support gp8300 chaokong board"
	select GPT_CHIP2
	select SUPPORT_SPL
config TARGET_GP8300_TCX
	bool "Support tcx haps board"
	select GPT_CHIP2
config TARGET_GP8300_HERA
	bool "Support hera board"
	select GPT_CHIP2

endchoice

source "arch/gpt/cpu/chip1/Kconfig"
source "arch/gpt/cpu/chip2/Kconfig"

source "board/gpt/chip1fpga/Kconfig"
source "board/gpt/chip1evk/Kconfig"
source "board/gpt/chip2fpga/Kconfig"
source "board/gpt/chip2evk/Kconfig"
source "board/gpt/chip2sim/Kconfig"
source "board/gpt/chasexilinx/Kconfig"
source "board/gpt/gp8300_fpga/Kconfig"
source "board/gpt/gp8300_evk/Kconfig"
source "board/gpt/gp8300_dvb/Kconfig"
source "board/gpt/gp8300_chaokong/Kconfig"
source "board/gpt/gp8300_tcx/Kconfig"
source "board/gpt/gp8300_hera/Kconfig"

menu "OS boot interface"

config GPT_BOOT_CMDLINE_LEGACY
	bool "Hand over legacy command line to Linux kernel"
	default y
	help
	  Enable this option if you want U-Boot to hand over the Yamon-style
	  command line to the kernel. All bootargs will be prepared as argc/argv
	  compatible list.

config GPT_BOOT_ENV_LEGACY
	bool "Hand over legacy environment to Linux kernel"
	default y
	help
	  Enable this option if you want U-Boot to hand over the Yamon-style
	  environment to the kernel. Information like memory size, initrd
	  address and size will be prepared as zero-terminated key/value list.

config GPT_BOOT_FDT
	bool "Hand over a flattened device tree to Linux kernel"
	default n
	help
	  Enable this option if you want U-Boot to hand over a flattened
	  device tree to the kernel. 

endmenu

config GPT_TCMBOOT
	bool "Boot from TCM"
	default n 
	help
	  Enable this option if you want boot from TCM.
	  The boot address is TCM address


config USE_ARCH_STRCPY
	bool "Use asm optimized strcpy"
	default y
	help
	  Enable this option if you want use the asm optimized strcpy.

config USE_ARCH_STRLEN
	bool "Use asm optimized strlen"
	default y
	help
	  Enable this option if you want use the asm optimized strlen.

config USE_ARCH_STRCMP
	bool "Use asm optimized strcmp"
	default y
	help
	  Enable this option if you want use the asm optimized strcmp.

config USE_ARCH_MEMSET
	bool "Use asm optimized memset"
	default n
	help
	  Enable this option if you want use the asm optimized memset.

config USE_ARCH_MEMCPY
	bool "Use asm optimized memcpy"
	default n
	help
	  Enable this option if you want use the asm optimized memcpy.

config USE_ARCH_MEMCMP
	bool "Use asm optimized memcmp"
	default n
	help
	  Enable this option if you want use the asm optimized memcmp.

menu "WatchDog"
config HW_WATCHDOG
	bool "Enable Hardware Watchdog"
	help
		Enable Hardware Watchdog.

config GPT_WATCHDOG
	bool "Use gpt watchdog"
	default y
	select HW_WATCHDOG
	help
		Enable this option if you want use the gpt apiu watchdog.
endmenu

endmenu
```

## arch/gpt/cpu/chip1/Kconfig
```kconfig
if GPT_CHIP1

config APIU
	bool "Enable apiu support"
	default y
	---help---
	Say Y here to enable APIU support

	
endif
```

## arch/gpt/cpu/chip2/Kconfig
```kconfig
if GPT_CHIP2

config APIU
	bool "Enable apiu support"
	default y
	---help---
	Say Y here to enable APIU support

	
endif
```

## arch/gpt/mach-chip2/Kconfig
```kconfig
if GPT_CHIP2

config GPT_CLOCK_SETTINGS
	bool "GPT CLOCK SETTINGS"
	default y

menu "GPT OSC FREQ"

config OSC_12MHZ
     	depends on GPT_CLOCK_SETTINGS
       	bool "OSC 12MHz"
       	default y

endmenu

choice
	prompt "GPT CPLL FREQ"
	default CPLL_1800MHZ

config CPLL_2000MHZ
     	depends on GPT_CLOCK_SETTINGS
       	bool "CPLL 2000MHz"
        help
	  Can not support GSNN

config CPLL_1900MHZ
     	depends on GPT_CLOCK_SETTINGS
       	bool "CPLL 1900MHz"

config CPLL_1800MHZ
     	depends on GPT_CLOCK_SETTINGS
       	bool "CPLL 1800MHz"

config CPLL_1600MHZ
     	depends on GPT_CLOCK_SETTINGS
       	bool "CPLL 1600MHz"

endchoice

choice
	prompt "GPT DDR3 DATA RATE"
	default DDR3_2133MBPS

config DDR3_2133MBPS
     	depends on GPT_CLOCK_SETTINGS
       	bool "DDR3 2133MBPS"

config DDR3_1600MBPS
     	depends on GPT_CLOCK_SETTINGS
       	bool "DDR3 1600MBPS"

endchoice

endif
```

## board/gpt/chasexilinx/Kconfig
```kconfig
if TARGET_CHASE_XILINX

config SYS_BOARD
	default "chasexilinx"

config SYS_VENDOR
        default "gpt"

config SYS_CONFIG_NAME
	default "chasexilinx"

endif
```

## board/gpt/chip1evk/Kconfig
```kconfig
if TARGET_CHIP1_EVK

config SYS_BOARD
	default "chip1evk"

config SYS_VENDOR
        default "gpt"

config SYS_CONFIG_NAME
	default "chip1evk"
endif
```

## board/gpt/chip1fpga/Kconfig
```kconfig
if TARGET_CHIP1_FPGA

config SYS_BOARD
	default "chip1fpga"

config SYS_VENDOR
        default "gpt"

config SYS_CONFIG_NAME
	default "chip1fpga"
endif
```

## board/gpt/chip2evk/Kconfig
```kconfig
if TARGET_CHIP2_EVK

config SYS_BOARD
	default "chip2evk"

config SYS_VENDOR
        default "gpt"

config SYS_CONFIG_NAME
	default "chip2evk"
endif
```

## board/gpt/chip2fpga/Kconfig
```kconfig
if TARGET_CHIP2_FPGA

config SYS_BOARD
	default "chip2fpga"

config SYS_VENDOR
        default "gpt"

config SYS_CONFIG_NAME
	default "chip2fpga"

endif
```

## board/gpt/chip2sim/Kconfig
```kconfig
if TARGET_CHIP2_SIM

config SYS_BOARD
	default "chip2sim"

config SYS_VENDOR
        default "gpt"

config SYS_CONFIG_NAME
	default "chip2sim"

endif
```

## board/gpt/gp8300_chaokong/Kconfig
```kconfig
if TARGET_GP8300_CHAOKONG

config SYS_BOARD
	default "gp8300_chaokong"

config SYS_VENDOR
        default "gpt"

config SYS_CONFIG_NAME
	default "gp8300_chaokong"

config GPT_NORFLASH_SUPPORT
	bool "Enable norflash operation"
	depends on GPT_SPI_NORFLASH
	help
	    support norfalsh operation API
endif
```

## board/gpt/gp8300_dvb/Kconfig
```kconfig
if TARGET_GP8300_DVB

config SYS_BOARD
	default "gp8300_dvb"

config SYS_VENDOR
        default "gpt"

config SYS_CONFIG_NAME
	default "gp8300_dvb"

config GPT_NORFLASH_SUPPORT
	bool "Enable norflash operation"
	depends on GPT_SPI_NORFLASH
	help
	    support norfalsh operation API

choice
	prompt "GPT Norflash Support"
	default GPT_NORFLASH_EXTEND_ADDR_MODE

config GPT_NORFLASH_4BYTE_ADDR_MODE
	bool "Enable norflash 4byte addr mode"
	depends on GPT_SPI_NORFLASH

config GPT_NORFLASH_EXTEND_ADDR_MODE
	bool "Enable norflash extend addr mode"
	depends on GPT_SPI_NORFLASH

endchoice

endif
```

## board/gpt/gp8300_evk/Kconfig
```kconfig
if TARGET_GP8300_EVK

config SYS_BOARD
	default "gp8300_evk"

config SYS_VENDOR
        default "gpt"

config SYS_CONFIG_NAME
	default "gp8300_evk"

config GPT_NORFLASH_SUPPORT
	bool "Enable norflash operation"
	depends on GPT_SPI_NORFLASH
	help
	    support norfalsh operation API
endif
```

## board/gpt/gp8300_fpga/Kconfig
```kconfig
if TARGET_GP8300_FPGA

config SYS_BOARD
	default "gp8300_fpga"

config SYS_VENDOR
        default "gpt"

config SYS_CONFIG_NAME
	default "gp8300_fpga"

config GPT_NORFLASH_SUPPORT
	bool "Enable norflash operation"
	depends on GPT_SPI_NORFLASH
	help
	    support norfalsh operation API
endif
```

## board/gpt/gp8300_hera/Kconfig
```kconfig
if TARGET_GP8300_HERA

config SYS_BOARD
	default "gp8300_hera"

config SYS_VENDOR
        default "gpt"

config SYS_CONFIG_NAME
	default "gp8300_hera"

endif
```

## board/gpt/gp8300_tcx/Kconfig
```kconfig
if TARGET_GP8300_TCX

config SYS_BOARD
	default "gp8300_tcx"

config SYS_VENDOR
        default "gpt"

config SYS_CONFIG_NAME
	default "gp8300_tcx"

config GPT_NORFLASH_SUPPORT
	bool "Enable norflash operation"
	depends on GPT_SPI_NORFLASH
	help
	    support norfalsh operation API
endif
```

## drivers/dma/Kconfig
```kconfig
menu "DMA drivers"

config GPT_CPU_DMA
	bool "cpu dma test"
	help
	 CPU DMA test

endmenu
```

## drivers/mtd/norflash/Kconfig
```kconfig
config GPT_SPI_NORFLASH
	bool "Enable SPI norflash drivers"
	help
	  Enable norflash device drivers
```

## drivers/video/adv/Kconfig
```kconfig
#
# hdmi configuration
#

menu "hdmi support"

config HDMI_ADV
	bool "Enable ADV driver support"
	default n
endmenu
```

## fs/ext4/Kconfig
```kconfig
menu "ext4 file systems"

config	FS_EXT4 
	bool "Enable ext4 file systems support"
	default y
	help
	  Support ext4 file systems

config	CMD_EXT4 
	bool "ext4 command support"
	default y
	help
	  Support ext4 command 

config	EXT4_WRITE 
	bool "ext4 write support"
	default y
	help
	  Support ext4 write 

config	CMD_EXT4_WRITE 
	bool "ext4 write command support"
	default y
	help
	  Support ext4 write command 

endmenu
```

## fs/fat/Kconfig
```kconfig
menu "fat file systems"

config	FS_FAT 
	bool "Enable fat file systems support"
	default y
	help
	  Support fat file systems

config	CMD_FAT 
	bool "fat command support"
	default y
	help
	  Support fat command 

config	FAT_WRITE 
	bool "fat write support"
	default y
	help
	  Support fat write 

config	CMD_FAT_WRITE 
	bool "fat write command support"
	default y
	help
	  Support fat write command 

endmenu
```

## test/Kconfig
```kconfig
menuconfig UNIT_TEST
	bool "Unit tests"
	help
	  Select this to compile in unit tests for various parts of
	  U-Boot. Test suites will be subcommands of the "ut" command.
	  This does not require sandbox to be included, but it is most
	  often used there.

config UT_TIME
	bool "Unit tests for time functions"
	depends on UNIT_TEST
	help
	  Enables the 'ut time' command which tests that the time functions
	  work correctly. The test is fairly simple and will not catch all
	  problems. But if you are having problems with udelay() and the like,
	  this is a good place to start.

config UT_STRING
	bool "Unit tests for string functions"
	depends on UNIT_TEST
	help
	  Enables the 'ut string' command which tests that the string functions
	  work correctly. The test is fairly simple and will not catch all
	  problems. 

source "test/dm/Kconfig"
source "test/env/Kconfig"
```
